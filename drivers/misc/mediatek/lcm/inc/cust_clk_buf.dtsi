/*
 * Generated by MTK SP DrvGen Version: 3.5.160809 for MT6797.
 * 2019-10-15 18:15:47
 * Do Not Modify The File.
 * Copyright Mediatek Inc. (c) 2016.
*/

/*************************
 * CLK_BUF DTSI File
*************************/

&pmic_clock_buffer_ctrl {
	mediatek,clkbuf-quantity = <4>;
	mediatek,clkbuf-config = <0 0 0 0>;
	mediatek,clkbuf-driving-current = <2 2 2 2>;
	status = "okay";
};

&rf_clock_buffer_ctrl {
	mediatek,clkbuf-quantity = <4>;
	mediatek,clkbuf-config = <2 0 1 1>;
	mediatek,clkbuf-driving-current = <2 2 2 2 >;
	status = "okay";
};
