/*
 * Generated by MTK SP DrvGen Version: 3.5.160809 for MT6797.
 * 2019-10-15 18:15:47
 * Do Not Modify The File.
 * Copyright Mediatek Inc. (c) 2016.
*/

&gpio_usage_mapping {
	GPIO_SIM1_HOT_PLUG = <112>;
	GPIO_SIM2_HOT_PLUG = <113>;
	GPIO_SIM1_SCLK = <126>;
	GPIO_SIM1_SRST = <127>;
	GPIO_SIM1_SIO = <128>;
	GPIO_SIM2_SCLK = <155>;
	GPIO_SIM2_SRST = <156>;
	GPIO_SIM2_SIO = <157>;
	GPIO_FDD_BAND_SUPPORT_DETECT_1ST_PIN = <194>;
	GPIO_FDD_BAND_SUPPORT_DETECT_2ND_PIN = <195>;
};
